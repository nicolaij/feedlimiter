## components/ht16k33/examples/default/main/Kconfig.projbuild
```kconfig
menu "Example configuration"
    config EXAMPLE_I2C_FREQUENCY_HZ
        int "I2C bus frequency"
        default 400000
        help
            I2C bus frequency.

    rsource "../../../Kconfig.i2c"
endmenu
```

## sdkconfig.defaults
```kconfig
# Reduce bootloader log verbosity
CONFIG_LOG_BOOTLOADER_LEVEL_INFO=y
CONFIG_LOG_BOOTLOADER_LEVEL=3

CONFIG_HTTPD_WS_SUPPORT=y
CONFIG_SPI_FLASH_SUPPORT_BOYA_CHIP=y

CONFIG_FREERTOS_HZ=1000

# Enable FreeRTOS stats formatting functions, needed for 'tasks' command
CONFIG_FREERTOS_USE_TRACE_FACILITY=y
CONFIG_FREERTOS_USE_STATS_FORMATTING_FUNCTIONS=y

# On chips with USB serial, disable secondary console which does not make sense when using console component
CONFIG_ESP_CONSOLE_SECONDARY_NONE=y

CONFIG_LOG_COLORS=y
CONFIG_LOG_DEFAULT_LEVEL_DEBUG=y
```
